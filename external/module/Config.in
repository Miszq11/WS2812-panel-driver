## external/module/Config.in
```kconfig
source "$BR2_EXTERNAL_WS2812_panel_PATH/package/WS2812_module/Config.in"
source "$BR2_EXTERNAL_WS2812_panel_PATH/package/WS2812_app/Config.in"
```

## external/module/package/WS2812_app/Config.in
```kconfig
config BR2_PACKAGE_WS2812_APP
    bool "ws2812_APP"
    help
      WS2812 test app for testing WS2812 module working
```

## external/module/package/WS2812_module/Config.in
```kconfig
comment "You need to enable BR2_LINUX_KERNEL for WS2812 module to work"
	depends on !BR2_LINUX_KERNEL
menuconfig BR2_PACKAGE_WS2812_MODULE
    bool "module for ws2812 communication support"
    depends on BR2_LINUX_KERNEL
    help
      WS2812 Panel module support

      see: datasheet of WS2812 led.
depends on BR2_LINUX_KERNEL

config BR2_PACKAGE_WS2812_MODULE_NO_DTS
		bool "compile module wersion with no dts startup"
		help
			this option will compile ws2812_mod module, that will hard lock it self
			to spi1 ch 0
depends on BR2_PACKAGE_WS2812_MODULE

config BR2_PACKAGE_WS2812_MODULE_DTS
		bool "compile module version with dts startup"
		help
			this option will compile ws2812_spi module, that should fireup after
			matching dts entry with key "swis,ws2812-panel"
depends on BR2_PACKAGE_WS2812_MODULE

choice
	prompt "automatic module startup"
	default BR2_PACKAGE_WS2812_INITD_NONE
	depends on BR2_PACKAGE_WS2812_MODULE && BR2_INIT_BUSYBOX

	config BR2_PACKAGE_WS2812_INITD_NONE
			bool "none"
			help
				No script will be dropped into /etc/init.d directory

	config BR2_PACKAGE_WS2812_INITD_INSTALL
			bool "install initd script for automatic module startup"
			help
				This option will enable dropping the ws2712_module_startup into
				/etc/init.d/ directory on target. This script will call
				"modprobe ws2812_spi"
	depends on BR2_PACKAGE_WS2812_MODULE && BR2_INIT_BUSYBOX

	config BR2_PACKAGE_WS2812_INITD_INSTALL_TEST
			bool "install initd script for automatic test module startup"
			help
				This option will enable dropping the ws2712_module_startup into
				/etc/init.d/ directory on target. This script will call
				"modprobe ws2812_mod".
	depends on BR2_PACKAGE_WS2812_MODULE && BR2_INIT_BUSYBOX
endchoice

comment "init.s script for automatic module startup requires BUSY_BOX"
	depends on BR2_PACKAGE_WS2812_MODULE && !BR2_INIT_BUSYBOX
```
